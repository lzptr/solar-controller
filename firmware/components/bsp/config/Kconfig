## firmware/components/bsp/config/Kconfig
```kconfig
menu "Board"

config BSP_LED_MAX
    int "LEDs the data line is sized for"
    range 1 128
    default 60 if LAMP_VARIANT_STRIP
    default 70
    help
        Frame buffer size. Ten globes with a seven-LED ring each, or one
        metre of strip with 60 LEDs/m. The number actually connected is set
        at runtime with the 'count' command.

endmenu
```

## firmware/components/encoder/config/Kconfig
```kconfig
menu "Encoder"

config ENCODER_COUNTS_PER_DETENT
    int "Quadrature edges per detent"
    range 1 4
    default 2
    help
        EC11J1525402: 15 pulses (60 edges) and 30 detents per turn.

config ENCODER_REVERSE
    bool "Reverse the turn direction"
    default n

endmenu
```

## firmware/components/lamp/config/Kconfig
```kconfig
menu "Lamp"

config LAMP_ENCODER_STEPS
    int "Encoder detents from off to full brightness"
    range 2 100
    default 30
    help
        30 is one full turn of the EC11. The steps rise in equal ratios from
        LAMP_MIN_BRIGHTNESS_PERMILLE to 100 %, so each one looks about as big.

config LAMP_MIN_BRIGHTNESS_PERMILLE
    int "Brightness of the first encoder step (permille of full)"
    range 1 1000
    default 20
    help
        SK6812 channels are 8 bit, so much lower makes dim colours drop out.

config LAMP_DEFAULT_BUDGET_MA
    int "Default LED current budget (mA)"
    range 50 2000
    default 1600
    help
        The highest budget allowed, so the full chain can reach full
        brightness (70 LEDs at full white take about 1.2 A). A laptop USB port
        may not supply that; lower it with 'budget', e.g. 400. Capped 200 mA
        below LAMP_OVERCURRENT_MA.

config LAMP_OVERCURRENT_MA
    int "Measured LED current that latches LED power off (mA)"
    range 300 2200
    default 1800
    help
        Just under U402's 2.04 A limit. The budget is capped 200 mA below.

endmenu
```

## firmware/components/led_ring/config/Kconfig
```kconfig
menu "LED ring"

config LED_RING_CHANNEL_FULL_UA
    int "Current of one SK6812 colour channel at 255 (uA)"
    range 1000 30000
    default 16000
    help
        Used to estimate the chain current for the limiter. Err on the high
        side; the measured-current guard corrects an underestimate.

config LED_RING_IDLE_UA
    int "Idle current of one SK6812 (uA)"
    range 0 5000
    default 1000

endmenu
```

## firmware/main/Kconfig.projbuild
```kconfig
menu "Solar Controller"

    choice LAMP_VARIANT
        prompt "Lamp"
        default LAMP_VARIANT_GLOBES
        help
            What hangs on the LED connector. 'idf.py --preset strip' selects
            the strip through sdkconfig.defaults.strip.

        config LAMP_VARIANT_GLOBES
            bool "Planet globes (SK6812 RGBW rings)"
            help
                Ten globes in their own colours; the button cycles colour,
                warm white and off.

        config LAMP_VARIANT_STRIP
            bool "LED strip (WS2812B RGB)"
            help
                One warm white mixed from red, green and blue; the button
                switches the strip on and off.
    endchoice

    # Keep fragments below component roots to avoid automatic duplicate inclusion.
    rsource "../components/bsp/config/Kconfig"
    rsource "../components/led_ring/config/Kconfig"
    rsource "../components/encoder/config/Kconfig"
    rsource "../components/lamp/config/Kconfig"

endmenu
```

## firmware/sdkconfig.defaults
```kconfig
CONFIG_ESPTOOLPY_FLASHMODE_DIO=y
CONFIG_ESPTOOLPY_FLASHFREQ_80M=y
CONFIG_ESPTOOLPY_FLASHSIZE_8MB=y
CONFIG_ESP_CONSOLE_USB_SERIAL_JTAG=y
CONFIG_ESP_CONSOLE_SECONDARY_NONE=y

CONFIG_BSP_BOARD_ESP32_C6_DEV_KIT_N8=y
CONFIG_BSP_LED_DATA_GPIO=7
CONFIG_BSP_LED_COUNT=7
CONFIG_LED_RING_BOOT_WHITE=255
CONFIG_LED_RING_BOOT_BRIGHTNESS=20
```
